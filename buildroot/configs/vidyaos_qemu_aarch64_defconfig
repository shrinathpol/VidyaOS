## buildroot/configs/vidyaos_qemu_aarch64_defconfig
```kconfig
# Target Architecture
BR2_aarch64=y
BR2_cortex_a53=y

# Toolchain settings
BR2_TOOLCHAIN_BUILDROOT_WCHAR=y
BR2_TOOLCHAIN_BUILDROOT_CXX=y
BR2_PACKAGE_HOST_LINUX_HEADERS_CUSTOM_6_6=y

# System Configuration
BR2_SYSTEM_DHCP="eth0"
BR2_TARGET_GENERIC_GETTY_PORT="ttyAMA0"
BR2_ROOTFS_OVERLAY="board/vidyaos/rootfs_overlay"

# Kernel
BR2_LINUX_KERNEL=y
BR2_LINUX_KERNEL_CUSTOM_VERSION=y
BR2_LINUX_KERNEL_CUSTOM_VERSION_VALUE="6.6.21"
BR2_LINUX_KERNEL_USE_CUSTOM_CONFIG=y
BR2_LINUX_KERNEL_CUSTOM_CONFIG_FILE="board/vidyaos/kernel.config"

# Target Packages
BR2_PACKAGE_BUSYBOX=y
BR2_PACKAGE_SDL2=y
BR2_PACKAGE_SDL2_KMSDRM=y
BR2_PACKAGE_MDEVD=y
BR2_PACKAGE_VIDYAOS_DESKTOP=y

# Filesystem Images
BR2_TARGET_ROOTFS_EXT2=y
BR2_TARGET_ROOTFS_EXT2_4=y
# BR2_TARGET_ROOTFS_TAR is not set
```

## buildroot/package/vidyaos-desktop/Config.in
```kconfig
config BR2_PACKAGE_VIDYAOS_DESKTOP
	bool "vidyaos-desktop"
	select BR2_PACKAGE_SDL2
	select BR2_PACKAGE_SDL2_KMSDRM
	help
	  The display compositor, window manager, and shell for VidyaOS.
```

## buildroot/package/vidyaos-native/Config.in
```kconfig
config BR2_PACKAGE_VIDYAOS_NATIVE
	bool "vidyaos-native"
	select BR2_PACKAGE_SDL2
	select BR2_PACKAGE_SDL2_KMSDRM
	select BR2_PACKAGE_SDL2_TTF
	select BR2_PACKAGE_LIBVTERM
	help
	  The native display compositor, window manager, and shell for VidyaOS.
```
